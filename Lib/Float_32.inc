/****************************************************************************
File:				Wait.inc
Author:				Rafa³ Dubniewski
Verssion			1.0
Created:			2014.03.21
Modified:			2014.03.21
****************************************************************************/

#ifndef _FLOAT_32_INC_
#define _FLOAT_32_INC_

/*
.def    R_MATH_A_0                     = r16
.def    R_MATH_A_1                     = r17
.def    R_MATH_A_2                     = r18
.def    R_MATH_A_3                     = r19
.def    R_MATH_B_0                     = r20
.def    R_MATH_B_1                     = r21
.def    R_MATH_B_2                     = r22
.def    R_MATH_B_3                     = r23
.def    R_MUL_TMP                      = r15 
*/

#define R_FLOAT_A_U16_0                 R_MATH_A_1
#define R_FLOAT_A_U16_1                 R_MATH_A_2

;----------------------------------------------------------------------------
.macro FLOAT_32_LDI
    ldi     @0_3, ((@1) >> 24) & 0xFF
    ldi     @0_2, ((@1) >> 16) & 0xFF
    ldi     @0_1, ((@1) >> 8) & 0xFF
    ldi     @0_0, ((@1) >> 0) & 0xFF
.endmacro
;----------------------------------------------------------------------------
.macro FLOAT_32_LDS
    lds     @0_3, @1_3
    lds     @0_2, @1_2
    lds     @0_1, @1_1
    lds     @0_0, @1_0
.endmacro
;----------------------------------------------------------------------------
.macro FLOAT_32_STS
    sts     @0_3, @1_3
    sts     @0_2, @1_2
    sts     @0_1, @1_1
    sts     @0_0, @1_0
.endmacro
;----------------------------------------------------------------------------
.macro FLOAT_32_PUSH
    push    @0_3
    push    @0_2
    push    @0_1
    push    @0_0
.endmacro
;----------------------------------------------------------------------------
.macro FLOAT_32_POP
    pop     @0_0
    pop     @0_1
    pop     @0_2
    pop     @0_3
.endmacro
;----------------------------------------------------------------------------
.macro FLOAT_32_MOV
    mov     @0_3, @1_3
    mov     @0_2, @1_2
    mov     @0_1, @1_1
    mov     @0_0, @1_0
.endmacro
;----------------------------------------------------------------------------
#endif
